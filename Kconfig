## Kconfig
```kconfig
menu "Engine Options"

config DEBUG
    bool "Enable Debug Mode"
    default n
    help
        Enable this option to compile the engine with debug symbols
        and additional logging.

config ENABLE_SANDBOX
    bool "Include Sandbox Application"
    default y
    help
        Enable this option to include the sandbox application in the build.

choice
    prompt "Log Level"
    default LOG_LEVEL_INFO
    help
        Select the logging level for the engine.

config LOG_LEVEL_DEBUG
    bool "Debug"
    help
        Enables debug-level logging.

config LOG_LEVEL_INFO
    bool "Info"
    help
        Enables info-level logging.

config LOG_LEVEL_WARN
    bool "Warning"
    help
        Enables warning-level logging.

config LOG_LEVEL_ERROR
    bool "Error"
    help
        Enables error-level logging.

endchoice

endmenu # Engine Options

menu "Compiler Options"

config OPTIMIZATION_LEVEL
    int "Optimization Level (0-3)"
    range 0 3
    default 2
    help
        Set the optimization level for the compiler:
        - 0: No optimization
        - 1: Optimize for size
        - 2: Balanced optimization (default)
        - 3: Optimize for speed

config ENABLE_WERROR
    bool "Treat Warnings as Errors"
    default n
    help
        If enabled, all compiler warnings will be treated as errors.

config EXTRA_CFLAGS
    string "Extra Compiler Flags"
    default ""
    help
        Additional flags to pass to the compiler.

endmenu # Compiler Options
```
